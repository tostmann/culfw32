## firmware/components/led_drv/Kconfig.projbuild
```kconfig
menu "CULFW32: LED Driver"

    config CULFW32_LED_PIN
        int "LED GPIO"
        default 8
        help
            CUL32-Serienhardware (CUL60.sch): LED1 (blau) haengt mit der Kathode
            an GPIO8, die Anode ueber R3 (820R) an VDD -> active LOW. R2 (10k)
            haelt den Strapping-Pin GPIO8 beim Boot high.

    config CULFW32_LED_ACTIVE_LOW
        bool "LED ist active LOW"
        default y

endmenu
```

## firmware/components/nvs_eeprom/Kconfig.projbuild
```kconfig
menu "CULFW32: NVS EEPROM (culfw EEPROM emulation)"

    config CULFW32_EEPROM_SIZE
        int "EEPROM size in bytes (a-culfw CUL_V3 = 1024)"
        range 256 8192
        default 1024

    config CULFW32_EEPROM_I2C
        bool "culfw-EEPROM im I2C-EEPROM U1 (M24C32) halten, NVS als Spiegel"
        default y
        help
            CUL32-Verkaufsstuecke tragen U1 (M24C32, CUL60.sch). Das Abbild
            liegt dann dort und ueberlebt wie beim AVR-CUL jedes Flashen, auch
            das Factory-Image des Web-Flashers. Ohne Baustein (Laborboards)
            arbeitet die Firmware wie bisher nur mit NVS.

    config CULFW32_EEPROM_I2C_SDA
        int "Pin SDA"
        depends on CULFW32_EEPROM_I2C
        default 22

    config CULFW32_EEPROM_I2C_SCL
        int "Pin SCL"
        depends on CULFW32_EEPROM_I2C
        default 23

    config CULFW32_EEPROM_I2C_WC
        int "Pin WC (high = schreibgeschuetzt, -1 = nicht verbunden)"
        depends on CULFW32_EEPROM_I2C
        default 15

    config CULFW32_EEPROM_I2C_ADDR
        hex "I2C-Adresse (7 bit)"
        depends on CULFW32_EEPROM_I2C
        default 0x50

    config CULFW32_EEPROM_I2C_HZ
        int "SCL-Frequenz (Hz)"
        depends on CULFW32_EEPROM_I2C
        range 100000 400000
        default 400000

    config CULFW32_EEPROM_I2C_BASE
        hex "Startadresse des culfw-Abbilds im M24C32"
        depends on CULFW32_EEPROM_I2C
        range 0x0 0x300
        default 0x0
        help
            Das Abbild muss ganz in den CULFW32-Bereich 0x0000..0x03FF passen,
            sonst bricht der Build ab. 0x0400..0x07ED gehoert q-culfw, ab
            0x07F0 liegen Scratch des Selbsttests und der Werksdatensatz
            (0x0800, "BWFD").

endmenu
```

## firmware/components/ota_update/Kconfig.projbuild
```kconfig
menu "CULFW32: Online-Update (install.busware.de)"

    config CULFW32_OTA_MANIFEST_URL
        string "Manifest-URL"
        default "https://install.busware.de/CUL/busware-cul-culfw32.manifest"
        help
            esp-web-tools-Manifest des Web-Flashers mit `version` und
            `ota.<chipFamily>.path` (Schema wie cdc2net). Zur Laufzeit per
            `?ota.url=` ueberschreibbar (nur RAM, fuer Staging-Tests).

    config CULFW32_OTA_CHIP_FAMILY
        string "chipFamily-Schluessel im Manifest"
        default "ESP32-C6"

    config CULFW32_OTA_TEST_CRASH_S
        int "NUR TEST: frisch per OTA geladenes Image nach N s abstuerzen lassen (0 = aus)"
        default 0
        help
            Beweist das Rollback-Gate: ein Image mit diesem Wert stuerzt im
            PENDING_VERIFY-Zustand ab, der Bootloader muss auf das vorige
            zurueckfallen. In Produkt-Builds immer 0.

endmenu
```

## firmware/components/transport_uart/Kconfig.projbuild
```kconfig
menu "CULFW32: UART Transport (USB-C SBU)"

    config CULFW32_UART_PORT
        int "UART port (0=UART0, 1=UART1)"
        range 0 1
        default 0
        help
            UART0 ist auf ESP32-C6 frei wenn ESP_CONSOLE_USB_SERIAL_JTAG primary
            console ist (default in CULFW32). UART0 wird in der CULFW32-Hardware
            ueber die USB-C SBU1/SBU2 Pins nach aussen gefuehrt, damit ein
            zweiter Mikrocontroller die culfw-Daten direkt seriell mitlesen kann.

    config CULFW32_UART_BAUD
        int "Baud rate"
        default 38400
        help
            38400 8N1 — kompatibel mit dem klassischen busware-CUL Default-Tempo
            und ausreichend Headroom fuer culfw Frame-Bursts.

    config CULFW32_UART_PIN_TX
        int "Pin TX"
        default 16
        help
            CUL32-Serienhardware (CUL60.sch): U0TXD = GPIO16 (Modul-Pad 31) geht
            auf USB-C SBU1 und zusaetzlich auf FFC J1.12. GPIO16/17 sind auf dem
            ESP32-C6 die IOMUX-UART0-Pins (ESP32-C6-MINI-1 Datenblatt Tab. 3-1),
            kollidieren also nicht mehr mit dem CC1101-SPI (18..21).

    config CULFW32_UART_PIN_RX
        int "Pin RX"
        default 17
        help
            U0RXD = GPIO17 (Modul-Pad 30), kommt ueber R12 (499R) von USB-C SBU2
            und liegt auf FFC J1.13.

endmenu
```
